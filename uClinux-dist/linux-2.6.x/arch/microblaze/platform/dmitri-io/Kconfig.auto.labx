## uClinux-dist/linux-2.6.x/drivers/net/labx_avb/Kconfig
```kconfig
#
# Lab X Technologies Audio / Video Bridging (AVB) packet engine
# device driver configuration
#

config LABX_AVB
	bool "Lab X Audio / Video Bridging (AVB) support"
	help
	  Enables options for various Lab X Technologies AVB packet engines

menu "Lab X AVB (IEEE1722) packet engine support"
	depends on LABX_AVB

config LABX_AUDIO_PACKETIZER
	bool "Audio packetizer engine support"
	help
	  This configures support for the Lab X AVB audio packetizer engine

config LABX_AUDIO_DEPACKETIZER
	bool "Audio depacketizer engine support"
	help
	  This configures support for the Lab X AVB audio depacketizer engine

config SOFTWARE_MUTE_ENABLED
	bool "Audio depacketizer software mute support"
	depends on LABX_AUDIO_DEPACKETIZER
    help
    	This configures support for the Lab X AVB software muting

config LABX_AUDIO_DEPACKETIZER_DMA
	bool "Audio depacketizer DMA interface support"
	depends on LABX_AUDIO_DEPACKETIZER
	depends on LABX_DMA
	help
	  This configures support for the Lab X DMA interface to the depacketizer

config LABX_AUDIO_TDM
	bool "Audio Time Domain Multiplexer support"
	help
	  This configures support for the Lab X AVB audio time domain multiplexer driver

config LABX_AUDIO_TDM_ANALYZER
	bool "Audio TDM analyzer support"
	help
	  This configures support for the Lab X AVB TDM audio analyzer

config LABX_LEGACY_BRIDGE
	bool "AVB Legacy Packet Bridge support"
	help
	  This configures support for the Lab X AVB legacy packet bridge driver

config LABX_REDUNDANCY_SWITCH
	bool "AVB Redundancy Switch support"
        depends on LABX_AUDIO_DEPACKETIZER
	help
	  This configures support for the Lab X AVB redundancy switch driver

config XILINX_AVB_SIMPLE_IPM
	bool "AVB Simple IPM support"
	depends on XILINX_LLTEMAC_AVB_LABX
	help
	  Say Y here if you want to include access for the Simple Input Packet Manager
	  to run as part of the TEMAC/AVB driver.

config XILINX_AVB_SIMPLE_IPM_NSTREAMS
	int "Number of AVB streams"
	depends on XILINX_AVB_SIMPLE_IPM
	default "1"
	help
	  This option specifies the number of AVB streams supported by the hardware


config XILINX_AVB_SIMPLE_OPM
	bool "AVB Simple OPM support"
	depends on XILINX_LLTEMAC_AVB_LABX
	help
	  Say Y here if you want to include access for the Simple Output Packet Manager
	  to run as part of the TEMAC/AVB driver.

config XILINX_VXCO_SYNC
	bool "Support for syncing a VCXO"
	depends on XILINX_AVB_SIMPLE_OPM
	help
	  Say Y here if you want to sync a VCXO to the dirty recovered word clock.

endmenu
```
